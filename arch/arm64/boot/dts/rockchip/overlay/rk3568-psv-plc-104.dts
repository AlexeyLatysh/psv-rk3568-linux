/dts-v1/;
/plugin/;

#include "rk3568-psv-plc_bb12.dtsi"

&{/} {
        model = "PLC PSV RK3568 10.4\"";
};

&tft_panel {
        width-mm = <210>;
        height-mm = <158>;
};

&display_timings {
        native-mode = <&timing1024x768>;
};

