/dts-v1/;
/plugin/;

#include "rk3568-psv-plc_bb12.dtsi"

&{/} {
        model = "PLC PSV RK3568 12.1\"";
};

&tft_panel {
        width-mm = <246>;
        height-mm = <184>;
};

&display_timings {
        native-mode = <&timing1024x768>;
};

