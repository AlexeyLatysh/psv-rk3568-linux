/dts-v1/;
/plugin/;

#include "rk3568-psv-plc_bb5.dtsi"

&{/} {
        model = "PLC PSV RK3568 10.1\"";
};

&tft_panel {
        width-mm = <223>;
        height-mm = <125>;
};

&display_timings {
        native-mode = <&timing1024x600>;
};

&touchscreen_rt {
        touchscreen-size-x = <1024>;
        touchscreen-size-y = <600>;
};
