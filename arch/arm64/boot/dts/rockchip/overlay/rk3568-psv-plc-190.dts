/dts-v1/;
/plugin/;

#include "rk3568-psv-plc_bb12.dtsi"

&{/} {
        model = "PLC PSV RK3568 19\"";
};

&tft_panel {
        width-mm = <375>;
        height-mm = <300>;
};

&display_timings {
        native-mode = <&timing1280x1024>;
};

&touchscreen {
        touchscreen-size-x = <1280>;
        touchscreen-size-y = <1024>;
};
