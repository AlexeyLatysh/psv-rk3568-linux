/dts-v1/;
/plugin/;

#include "rk3568-psv-plc_bb12.dtsi"

&{/} {
    model = "PLC PSV RK3568 21.5\"";
};

&tft_panel {
    width-mm = <476>;
    height-mm = <268>;
};

&display_timings {
    native-mode = <&timing1920x1080>;
};

&touchscreen {
        touchscreen-size-x = <1920>;
        touchscreen-size-y = <1080>;
};
